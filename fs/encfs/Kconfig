## fs/encfs/Kconfig
```kconfig
# SPDX-License-Identifier: Apache-2.0

menuconfig ENCFSMGR
	bool "Encrypted data volume manager"
	default n
	depends on FS_ENCPATHFS && FS_FATFS && BLKCRYPT
	depends on BOARDCTL_UNIQUEKEY && BOARDCTL_UNIQUEKEY_SIZE = 32
	depends on !DISABLE_MOUNTPOINT && !DISABLE_PSEUDOFS_OPERATIONS
	select CRYPTO_HKDF_SHA256
	---help---
		Manage a single encrypted volume: /dev/virtblk1 -> /dev/encdata0
		-> hidden FatFs /datap -> authenticated name layer /data.
		Normal start only mounts and authenticates existing metadata.
		The separate provision operation DESTRUCTIVELY formats the data disk
		as exFAT. The board unique key must provide 32 bytes of key material.

if ENCFSMGR

config ENCFS_TESTING
	bool "Enable encrypted volume fault injection and test keys"
	default n
	---help---
		Expose test-only APIs for an explicit 32-byte master, a missing master,
		and one-shot register/key/lower/upper errors. Runtime key replacement
		is rejected. Do not enable this option in production firmware.

endif
```

## fs/encpathfs/Kconfig
```kconfig
# SPDX-License-Identifier: Apache-2.0

config FS_ENCPATHFS
	bool "Authenticated encrypted filename file system"
	default n
	depends on !DISABLE_MOUNTPOINT
	depends on FS_FATFS
	depends on NAME_MAX >= 234
	depends on PATH_MAX >= 256
	select CRYPTO_SW_AES
	select CRYPTO_AES_SIV
	---help---
		A single-volume filesystem proxy using AES-SIV authenticated
		component names and canonical uppercase Base32hex encoding.
		The lower mounted filesystem must support syncfs and 234-byte
		names.  Logical names are printable ASCII, at most 128 bytes.
		Provision the lower volume explicitly before mounting; normal
		mounts only validate existing metadata and never format data.
```
